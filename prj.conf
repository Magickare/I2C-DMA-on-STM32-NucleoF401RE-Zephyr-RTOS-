## CMakeLists.txt
```
cmake_minimum_required(VERSION 3.13.1)

include($ENV{ZEPHYR_BASE}/cmake/app/boilerplate.cmake NO_POLICY_SCOPE)
project(i2c_dma_project)

target_sources(app PRIVATE src/main.c src/i2c_dma.c)
```

## west.yml
```
manifest:
  version: "0.13"

  defaults:
    remote: zephyrproject

  remotes:
    - name: zephyrproject
      url-base: https://github.com/zephyrproject-rtos

  projects:
    - name: zephyr
      path: zephyr
      revision: v3.5.0  # Change to the Zephyr version you are using
      import: true

  self:
    path: app
```

## prj.conf
```kconfig
CONFIG_STDOUT_CONSOLE=y
CONFIG_LOG=y
CONFIG_I2C=y
CONFIG_DMA=y
CONFIG_I2C_DMA=y
CONFIG_I2C_STM32_DMA=y
CONFIG_UART_CONSOLE=y
```

## dts/stm32f401re.overlay
```dts
&i2c1 {
    status = "okay";
    pinctrl-0 = <&i2c1_scl_pa9 &i2c1_sda_pa10>;
    pinctrl-names = "default";
    clock-frequency = <I2C_BITRATE_FAST>;

    dma-channel {
        status = "okay";
        zephyr,dma-channel = <1>;
    };
};
```

## src/main.c
```c
#include <zephyr/kernel.h>
#include <zephyr/device.h>
#include <zephyr/drivers/i2c.h>
#include <zephyr/logging/log.h>
#include "board.h"

LOG_MODULE_REGISTER(main, LOG_LEVEL_DBG);

#define I2C_DEV DT_LABEL(DT_NODELABEL(i2c1))
#define I2C_SLAVE_ADDR 0x68  // Example slave address (modify accordingly)

static const struct device *i2c_dev;

void main(void) {
    LOG_INF("Initializing board...");
    board_init();

    LOG_INF("Starting I2C DMA Example");

    i2c_dev = device_get_binding(I2C_DEV);
    if (!i2c_dev) {
        LOG_ERR("Failed to get I2C device");
        return;
    }

    uint8_t data_write[2] = {0x00, 0xFF}; // Example data
    uint8_t data_read[2];

    // Write data
    if (i2c_write(i2c_dev, data_write, sizeof(data_write), I2C_SLAVE_ADDR) != 0) {
        LOG_ERR("I2C write failed");
    } else {
        LOG_INF("I2C write successful");
    }

    // Read data
    if (i2c_read(i2c_dev, data_read, sizeof(data_read), I2C_SLAVE_ADDR) != 0) {
        LOG_ERR("I2C read failed");
    } else {
        LOG_INF("I2C read successful: 0x%X, 0x%X", data_read[0], data_read[1]);
    }
}
```

## include/board.h
```c
#ifndef BOARD_H
#define BOARD_H

#include <zephyr/kernel.h>
#include <zephyr/device.h>
#include <zephyr/devicetree.h>
#include <zephyr/drivers/i2c.h>

// Define the I2C instance being used
#define I2C_DEV DT_LABEL(DT_NODELABEL(i2c1))

// Define the I2C slave device address (modify as needed)
#define I2C_SLAVE_ADDR 0x68  

// Define DMA channel (modify according to hardware setup)
#define DMA_CHANNEL 1

// Function to initialize board-specific peripherals
void board_init(void);

#endif // BOARD_H
```

## src/i2c_dma.c
```c
#include "i2c_dma.h"
#include "board.h"
#include <zephyr/kernel.h>
#include <zephyr/device.h>
#include <zephyr/drivers/i2c.h>
#include <zephyr/drivers/dma.h>
#include <zephyr/logging/log.h>

LOG_MODULE_REGISTER(i2c_dma, LOG_LEVEL_DBG);

#define I2C_DEV DT_LABEL(DT_NODELABEL(i2c1))
#define DMA_DEV DT_LABEL(DT_NODELABEL(dma1))

static const struct device *i2c_dev;
static const struct device *dma_dev;

void i2c_dma_init(void) {
    i2c_dev = device_get_binding(I2C_DEV);
    dma_dev = device_get_binding(DMA_DEV);

    if (!i2c_dev || !dma_dev) {
        LOG_ERR("Failed to get I2C or DMA device");
        return;
    }

    LOG_INF("I2C and DMA initialized");
}

int i2c_dma_transfer(uint8_t *tx_buf, uint8_t *rx_buf, size_t len, uint16_t addr) {
    if (i2c_write(i2c_dev, tx_buf, len, addr) != 0) {
        LOG_ERR("I2C write failed");
        return -1;
    }

    if (i2c_read(i2c_dev, rx_buf, len, addr) != 0) {
        LOG_ERR("I2C read failed");
        return -1;
    }

    LOG_INF("I2C DMA Transfer Successful");
    return 0;
}
```

## src/i2c_dma.h
```c
#ifndef I2C_DMA_H
#define I2C_DMA_H

#include <zephyr/types.h>

void i2c_dma_init(void);
int i2c_dma_transfer(uint8_t *tx_buf, uint8_t *rx_buf, size_t len, uint16_t addr);

#endif // I2C_DMA_H
```
